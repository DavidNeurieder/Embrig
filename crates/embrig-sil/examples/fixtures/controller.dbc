VERSION "0.1"

NS_ :

BS_:

BU_: Vector__XXX

BO_ 256 SensorInput: 8 Vector__XXX
 SG_ temperature : 0|16@1+ (0.1,0) [0|200] ""  Vector__XXX

BO_ 512 ValveCommand: 8 Vector__XXX
 SG_ valve_open : 0|1@1+ (1,0) [0|1] ""  Vector__XXX

VAL_ 512 valve_open 0 "CLOSED" 1 "OPEN" ;
